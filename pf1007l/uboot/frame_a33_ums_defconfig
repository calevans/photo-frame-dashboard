## pf1007l/uboot/frame_a33_ums_defconfig
```kconfig
CONFIG_ARM=y
CONFIG_ARCH_SUNXI=y
CONFIG_DEFAULT_DEVICE_TREE="sun8i-a33-sinlinx-sina33"
CONFIG_SPL=y
CONFIG_MACH_SUN8I_A33=y
CONFIG_DRAM_ZQ=15291
CONFIG_MMC_SUNXI_SLOT_EXTRA=2
CONFIG_USB0_ID_DET="PH8"
# CONFIG_SYS_MALLOC_CLEAR_ON_INIT is not set
CONFIG_CMD_DFU=y
CONFIG_DFU_RAM=y
CONFIG_FASTBOOT_CMD_OEM_FORMAT=y
CONFIG_USB_EHCI_HCD=y
CONFIG_USB_OHCI_HCD=y
CONFIG_USB_MUSB_GADGET=y
CONFIG_USB_FUNCTION_MASS_STORAGE=y
# CONFIG_VIDEO_SUNXI is not set
CONFIG_CMD_USB_MASS_STORAGE=y
CONFIG_BOOTDELAY=0
CONFIG_USE_BOOTCOMMAND=y
CONFIG_DRAM_CLK=456
CONFIG_SUNXI_NO_PMIC=y
CONFIG_SYS_CLK_FREQ=408000000
CONFIG_USE_PREBOOT=y
CONFIG_PREBOOT="setenv stdin nulldev"
CONFIG_BOOTCOMMAND="echo FRAMELOG-START; ums 0 mmc 1; echo FRAMELOG-UMS-EXIT; dcache off; icache off; go 0xffff0020"
CONFIG_CONSOLE_RECORD=y
CONFIG_CONSOLE_RECORD_OUT_SIZE=0x10000
CONFIG_CMD_CACHE=y
CONFIG_WDT=y
CONFIG_WDT_SUNXI=y
CONFIG_WATCHDOG_AUTOSTART=y
CONFIG_WATCHDOG_TIMEOUT_MSECS=16000
```
